/**	
 * |----------------------------------------------------------------------
 * | Copyright (C) Tilen Majerle, 2014
 * | 
 * | This program is free software: you can redistribute it and/or modify
 * | it under the terms of the GNU General Public License as published by
 * | the Free Software Foundation, either version 3 of the License, or
 * | any later version.
 * |  
 * | This program is distributed in the hope that it will be useful,
 * | but WITHOUT ANY WARRANTY; without even the implied warranty of
 * | MERCHANTABILITY or FITNESS FOR A PARTICULAR PURPOSE.  See the
 * | GNU General Public License for more details.
 * | 
 * | You should have received a copy of the GNU General Public License
 * | along with this program.  If not, see <http://www.gnu.org/licenses/>.
 * |----------------------------------------------------------------------
 */
 #include "tm_graphic_driver_pcd8544.h"

unsigned char PCD8544_Buffer[PCD8544_BUFFER_SIZE];
unsigned char PCD8544_x;
unsigned char PCD8544_y;
uint8_t PCD8544_InInit = 0;

/* Font 5x7 */
const uint8_t PCD8544_Font5x7[97][5] = {
	{ 0x00, 0x00, 0x00, 0x00, 0x00 },   // sp
	{ 0x00, 0x00, 0x2f, 0x00, 0x00 },   // !
	{ 0x00, 0x07, 0x00, 0x07, 0x00 },   // "
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	{ 0x00, 0x7F, 0x3E, 0x1C, 0x08 }    // Play			128
};

/* Font 3x5 */
const uint8_t PCD8544_Font3x5[106][3] = {
	{ 0x00, 0x00, 0x00 },   // sp - 32
	{ 0x00, 0x17, 0x00 },   // ! - 33
	{ 0x03, 0x00, 0x03 },   // " - 34
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	{ 0x1F, 0x1F, 0x1F },   // delete
};


TM_GRAPHIC_Result TM_GRAPHICLCDDriver_Init(TM_GRAPHIC_Options_t* LCD_Options) {
	/* In init, used for DMA settings */
	PCD8544_InInit = 1;
	
	/* Initialize IO's */
	TM_PCD8544_InitIO();
	
	/* Reset */
	PCD8544_RST_LOW;
	TM_PCD8544_Delay(10000);
	PCD8544_RST_HIGH;

	/* Go in extended mode */
	TM_PCD8544_WriteCommand(PCD8544_FUNCTIONSET | PCD8544_EXTENDEDINSTRUCTION);

	/* LCD bias select */
	TM_PCD8544_WriteCommand(PCD8544_SETBIAS | 0x4);

	/* Set VOP */
	TM_PCD8544_WriteCommand(PCD8544_SETVOP | (PCD8544_CONTRAST < 0x7F ? PCD8544_CONTRAST : 0x7F));

	/* Normal mode */
	TM_PCD8544_WriteCommand(PCD8544_FUNCTIONSET);

	/* Set display to Normal */
	TM_PCD8544_WriteCommand(PCD8544_DISPLAYCONTROL | PCD8544_DISPLAYNORMAL);

	/* Set cursor to home position */
	TM_PCD8544_Home();

	/* Normal display */
	TM_PCD8544_WriteCommand(PCD8544_DISPLAYCONTROL | PCD8544_DISPLAYNORMAL);
	
	/* Not In init anymore, used for DMA settings */
	PCD8544_InInit = 0;
	
	/* Init DMA, Start transfering */
	TM_PCD8544_InitDMA();
	
	/* Set settings for GRAPHIC */
	LCD_Options->DefaultWidth = 48;
	LCD_Options->DefaultHeight = 84;
	
	/* Return OK */
	return TM_GRAPHIC_OK;
}

TM_GRAPHIC_Result TM_GRAPHICLCDDriver_Rotate(TM_GRAPHIC_Options_t* LCD_Options, TM_GRAPHIC_Orientation_t orientation) {

	/* Return OK */
	return TM_GRAPHIC_OK;
}

TM_GRAPHIC_Result TM_GRAPHICLCDDriver_Fill(TM_GRAPHIC_Options_t* LCD_Options, uint32_t color) {
	uint16_t i;
	uint8_t c;
	/* If color == 0x00, we want black color, so fill data */
	c = color == 0x00 ? 0xFF : 0x00;
	for (i = 0; i < PCD8544_BUFFER_SIZE; i++) {
		PCD8544_Buffer[i] = c;
	} 
	/* Return OK */
	return TM_GRAPHIC_OK;
}

TM_GRAPHIC_Result TM_GRAPHICLCDDriver_DrawPixel(TM_GRAPHIC_Options_t* LCD_Options, uint16_t x, uint16_t y, uint32_t color) {
	uint8_t tmp;
	
	if (LCD_Options->Orientation == TM_GRAPHIC_Orientation_Portrait_1) {
		/* Portrait 1 = 0 Degrees */
		tmp = y;
		y = x;
		x = PCD8544_WIDTH - tmp - 1;
	} else if (LCD_Options->Orientation == TM_GRAPHIC_Orientation_Portrait_2) {
		/* Portrait 2 = 180 Degrees */
		tmp = x;
		x = y;
		y = PCD8544_HEIGHT - tmp - 1;
	} else if (LCD_Options->Orientation == TM_GRAPHIC_Orientation_Landscape_1) {
		/* Landscape 1 = 90 Degrees */
	} else {
		/* Landscape 2 = 270 Degrees */
		x = PCD8544_WIDTH - x - 1;
		y = PCD8544_HEIGHT - y - 1;
	}
	
	if (color == 0x00) {
		/* Set pixel */
		PCD8544_Buffer[x + (y / 8) * PCD8544_WIDTH] |= 1 << (y % 8);
	} else {
		/* Clear pixel */
		PCD8544_Buffer[x + (y / 8) * PCD8544_WIDTH] &= ~(1 << (y % 8));
	}
	
	/* Return OK */
	return TM_GRAPHIC_OK;
}

void TM_PCD8544_InitIO(void) {
	GPIO_InitTypeDef GPIO_InitStruct;
	
	/* Enable clock for all pins */
	RCC_AHB1PeriphClockCmd(PCD8544_RST_RCC | PCD8544_CE_RCC | PCD8544_DC_RCC, ENABLE);

	/* Common settings for all pins */
	GPIO_InitStruct.GPIO_OType = GPIO_OType_PP;
	GPIO_InitStruct.GPIO_PuPd = GPIO_PuPd_NOPULL;
	GPIO_InitStruct.GPIO_Speed = GPIO_Speed_100MHz;
	GPIO_InitStruct.GPIO_Mode = GPIO_Mode_OUT;
	
	/* RST pin */
	GPIO_InitStruct.GPIO_Pin = PCD8544_RST_PIN;
	GPIO_Init(PCD8544_RST_PORT, &GPIO_InitStruct);
	
	/* DC pin */
	GPIO_InitStruct.GPIO_Pin = PCD8544_DC_PIN;
	GPIO_Init(PCD8544_DC_PORT, &GPIO_InitStruct);
	
	/* CE pin */
	GPIO_InitStruct.GPIO_Pin = PCD8544_CE_PIN;
	GPIO_Init(PCD8544_CE_PORT, &GPIO_InitStruct);

	/* Reset pin HIGH */
	GPIO_SetBits(PCD8544_RST_PORT, PCD8544_RST_PIN);
	
	/* CE HIGH */
	PCD8544_CE_HIGH;

	/* Initialize SPI */
	TM_SPI_Init(PCD8544_SPI, PCD8544_SPI_PINSPACK);
}

void TM_PCD8544_Delay(unsigned long micros) {
	volatile unsigned long i;
	for (i = 0; i < micros; i++) {

	}
}

void TM_PCD8544_WriteData(uint8_t data) {
	/* Send data */
	PCD8544_DC_HIGH;
	//Send data
	TM_PCD8544_Send(data);
}

void TM_PCD8544_WriteCommand(uint8_t command) {
	/* Send data */
	PCD8544_DC_LOW;
	//Send data
	TM_PCD8544_Send(command);
}

void TM_PCD8544_Send(uint8_t data) {
	/* CE low */
	PCD8544_CE_LOW;
	/* Send data */
	TM_SPI_Send(PCD8544_SPI, data);
	/* CE high */
	PCD8544_CE_HIGH;
}

void TM_PCD8544_Invert(PCD8544_Invert_t invert) {
	/* Stop transfer data */
	TM_PCD8544_DeInitDMA();
	
	if (invert != PCD8544_Invert_No) {
		TM_PCD8544_WriteCommand(PCD8544_DISPLAYCONTROL | PCD8544_DISPLAYINVERTED);
	} else {
		TM_PCD8544_WriteCommand(PCD8544_DISPLAYCONTROL | PCD8544_DISPLAYNORMAL);
	}
}

void TM_PCD8544_Home(void) {
	TM_PCD8544_WriteCommand(PCD8544_SETXADDR | 0);
	TM_PCD8544_WriteCommand(PCD8544_SETYADDR | 0);
}

void TM_PCD8544_InitDMA(void) {
	DMA_InitTypeDef DMA_InitStruct;
	
	if (PCD8544_InInit) {
		return;
	}
	
	/* STOP DMA first */
	TM_PCD8544_DeInitDMA();
	/* Little delay */
	TM_PCD8544_Delay(1000);
	/* Go to 0, 0 location on the LCD */
	TM_PCD8544_WriteCommand(PCD8544_SETXADDR | 0);
	TM_PCD8544_WriteCommand(PCD8544_SETYADDR | 0);
	/* Start send data */
	PCD8544_DC_HIGH;
	
	
	/* Enable clock for DMA */
	RCC_AHB1PeriphClockCmd(PCD8544_DMA_RCC, ENABLE);
	
	/* Set DMA options */
	DMA_InitStruct.DMA_BufferSize = PCD8544_BUFFER_SIZE;					/* 504 bytes */
	DMA_InitStruct.DMA_Channel = PCD8544_DMA_CHANNEL;						/* DMA channel for SPI TX */
	DMA_InitStruct.DMA_DIR = DMA_DIR_MemoryToPeripheral;					/* Transfer data from memory to peripheral */
	DMA_InitStruct.DMA_FIFOMode = DMA_FIFOMode_Disable;						/* Disable FIFO mode */
	DMA_InitStruct.DMA_Memory0BaseAddr = (uint32_t)PCD8544_Buffer;			/* Location for Data buffer */
	DMA_InitStruct.DMA_MemoryBurst = DMA_MemoryBurst_Single;				/* Single memory burst */
	DMA_InitStruct.DMA_MemoryDataSize = DMA_MemoryDataSize_Byte;			/* Data length byte */
	DMA_InitStruct.DMA_MemoryInc = DMA_MemoryInc_Enable;					/* Enable increase memory pointer after each transfer */
	DMA_InitStruct.DMA_Mode = DMA_Mode_Circular;							/* Normal mode, stop DMA after all transfered */
	DMA_InitStruct.DMA_PeripheralBaseAddr = (uint32_t)(&PCD8544_SPI->DR);	/* SPI Data register location */
	DMA_InitStruct.DMA_PeripheralBurst = DMA_PeripheralBurst_Single;		/* Single peripheral burst */
	DMA_InitStruct.DMA_PeripheralDataSize = DMA_MemoryDataSize_Byte;		/* Memory data size is byte */
	DMA_InitStruct.DMA_PeripheralInc = DMA_PeripheralInc_Disable;			/* Disable increase peripheral pointer after each transmit */
	DMA_InitStruct.DMA_Priority = DMA_Priority_High;						/* High priority */
	
	/* Init DMA */
	DMA_Init(PCD8544_DMA_STREAM, &DMA_InitStruct);
	/* Enable DMA */
	DMA_Cmd(PCD8544_DMA_STREAM, ENABLE);
	/* Enable SPI transmit DMA */
	SPI_I2S_DMACmd(PCD8544_SPI, SPI_I2S_DMAReq_Tx, ENABLE);
	/* CE pin low to start transfer data */
	PCD8544_CE_LOW;
}

void TM_PCD8544_DeInitDMA(void) {
	/* Disable DMA */
	DMA_Cmd(PCD8544_DMA_STREAM, DISABLE);
	/* Disable SPI transmit DMA */
	SPI_I2S_DMACmd(PCD8544_SPI, SPI_I2S_DMAReq_Tx, DISABLE);
	
	/* CE high to stop transfer data */
	PCD8544_CE_HIGH;
}

